## main/Kconfig.projbuild
```kconfig
menu "Miner Configuration"
    config AUTO_SCREEN_OFF
        bool "Screen auto-off"
        default n
        help
            Screen turns automatically off

    config AUTO_SCREEN_OFF_VALUE
        int
        default 1 if AUTO_SCREEN_OFF
        default 0

    config OVERHEAT_TEMP
        int "Overheat temperature threshold (°C)"
        range 50 90
        default 70
        help
            The temperature at which the system will trigger an overheat shutdown.

    choice
        prompt "Fan speed control mode"
        default FAN_MODE_MANUAL
        help
            Select how the firmware controls the fan speed.

    config FAN_MODE_MANUAL
        bool "Manual"
        help
            Manual fan control. You set the fan speed yourself.

    config FAN_MODE_PID
        bool "Experimental PID"
        help
            Automatically adjusts fan speed using a PID controller.

    endchoice


    config FAN_SPEED
        int "Manual fan speed percentage (if auto control is off)"
        range 0 100
        default 100
        help
            Fan speed in percentage. Only used if auto fan speed is disabled.

endmenu

menu "Stratum Configuration"

    config STRATUM_URL
        string "Stratum Address"
        default "public-pool.io"
        help
            The example will connect to this Stratum pool address.

    config STRATUM_PORT
        int "Stratum Port"
        range 0 65535
        default 21496
        help
            The stratum server port to connect to.

    config STRATUM_USER
        string "Stratum username"
        default "bc1q7n70rumyv6lvu8avpml0c3uggvssfu52egum3q.nerdqaxe"
        help
            Stratum user to use with pool

    config STRATUM_PW
        string "Stratum password"
        default "x"
        help
            Stratum password to use with pool

    config STRATUM_ENONCE_SUBSCRIBE
        bool "Enable Extranone Subscribe"
        default n
        help
            Enable or disable extranonce subscription

    config STRATUM_ENONCE_SUBSCRIBE_VALUE
        int
        default 1 if STRATUM_ENONCE_SUBSCRIBE
        default 0

    config STRATUM_FALLBACK_URL
        string "Stratum fallback Address"
        default ""
        help
            The fallback stratum server host

    config STRATUM_FALLBACK_PORT
        int "Stratum fallback Port"
        range 0 65535
        default 0
        help
            The fallback stratum server port to connect to.

    config STRATUM_FALLBACK_USER
        string "Stratum fallback username"
        default ""
        help
            Stratum user to use with fallback pool

    config STRATUM_FALLBACK_PW
        string "Stratum fallback password"
        default ""
        help
            Stratum password to use with fallback pool

    config STRATUM_FALLBACK_ENONCE_SUBSCRIBE
        bool "Enable Fallback Extranone Subscribe"
        default n
        help
            Enable or disable extranonce subscription

    config STRATUM_FALLBACK_ENONCE_SUBSCRIBE_VALUE
        int
        default 1 if STRATUM_FALLBACK_ENONCE_SUBSCRIBE
        default 0

    config STRATUM_DIFFICULTY
        int "Stratum default difficulty"
        range 0 4294967296
        default 1000
        help
            A starting difficulty to use with the pool.

endmenu

menu "InfluxDB Configuration"
    # Enable or disable the InfluxDB integration
    config INFLUX_ENABLE
        bool "Enable InfluxDB"
        default n
        help
            Enable or disable the InfluxDB integration in the firmware.
            When enabled, the firmware will send data to the specified InfluxDB server.

    config INFLUX_ENABLE_VALUE
        int
        default 1 if INFLUX_ENABLE
        default 0

    # Specify the URL of the InfluxDB server
    config INFLUX_URL
        string "InfluxDB URL"
        default "http://192.168.0.123"
        help
            The URL of the InfluxDB server in your home network.
            This should include the protocol (e.g., http://) and the IP address or hostname of the server.

    # Set the port number for the InfluxDB server
    config INFLUX_PORT
        int "InfluxDB Port"
        range 0 65535
        default 8086
        help
            The port number used to connect to the InfluxDB server.
            Ensure that this port is open and correctly configured on your server.

    # Token used for authentication with InfluxDB
    config INFLUX_TOKEN
        string "InfluxDB Token"
        default "f37fh783hf8hq"
        help
            The authentication token required to connect to your InfluxDB instance.
            This token must have appropriate permissions to write data to the specified bucket.

    # Specify the InfluxDB bucket where data will be stored
    config INFLUX_BUCKET
        string "InfluxDB Bucket"
        default "nerdqaxeplus"
        help
            The bucket in InfluxDB where your data will be stored.
            A bucket is a named location in InfluxDB that stores data, similar to a database in other systems.

    # Specify the organization in InfluxDB
    config INFLUX_ORG
        string "InfluxDB Org"
        default "nerdqaxeplus"
        help
            The organization in InfluxDB that owns the specified bucket.
            Organizations are used to logically separate data and resources within InfluxDB.

    # Set the prefix for measurement names in InfluxDB
    config INFLUX_PREFIX
        string "InfluxDB Prefix"
        default "mainnet_stats"
        help
            The prefix for measurement names in InfluxDB.
            This prefix will be prepended to all measurement names, allowing you to easily identify related data.

endmenu

menu "Discord Alert Configuration"

    # Enable/disable specific Discord alerts
    config ALERT_DISCORD_WATCHDOG_ENABLE
        bool "Watchdog alert"
        default n
        help
            Sends a Discord alert if the miner watchdog triggers
            (e.g. device reboots after failing to submit a share for ~1 hour).

    config ALERT_DISCORD_BLOCK_FOUND_ENABLE
        bool "Block-found alert"
        default n
        help
            Sends a Discord alert when your miner finds a block.

    # Internal 0/1 mirrors for C code that prefers ints
    config ALERT_DISCORD_WATCHDOG_ENABLE_VALUE
        int
        default 1 if ALERT_DISCORD_ENABLE
        default 0

    config ALERT_DISCORD_BLOCK_FOUND_ENABLE_VALUE
        int
        default 1 if ALERT_DISCORD_BLOCK_FOUND_ENABLE
        default 0

    # Webhook URL for sending Discord alerts (only shown if any alert is enabled)
    config ALERT_DISCORD_URL
        string "Discord webhook URL"
        default ""
        help
            Full Discord webhook URL used for all enabled alerts.
            Example: https://discord.com/api/webhooks/<id>/<token>
            Obtain it from your Discord server under: Integrations → Webhooks.
            Note: This is stored in plaintext in the firmware unless overridden at runtime.

endmenu

menu "Stratum Keepalive Configuration"

    config STRATUM_KEEPALIVE_ENABLE
        bool "Enable TCP Keepalive for Stratum connection"
        default y
        help
            Enables TCP keepalive on the Stratum socket to detect broken connections.

    config STRATUM_KEEPALIVE_ENABLE_VALUE
        int
        default 1 if STRATUM_KEEPALIVE_ENABLE
        default 0

endmenu

menu "WiFi Configuration"

    config ESP_WIFI_SSID
        string "WiFi SSID"
        default "myssid"
        help
            SSID (network name) for the example to connect to.

    config ESP_WIFI_PASSWORD
        string "WiFi Password"
        default "mypassword"
        help
            WiFi password (WPA or WPA2) for the example to use.

    choice ESP_WIFI_SAE_MODE
        prompt "WPA3 SAE mode selection"
        default ESP_WPA3_SAE_PWE_BOTH
        help
            Select mode for SAE as Hunt and Peck, H2E or both.
        config ESP_WPA3_SAE_PWE_HUNT_AND_PECK
            bool "HUNT AND PECK"
        config ESP_WPA3_SAE_PWE_HASH_TO_ELEMENT
            bool "H2E"
        config ESP_WPA3_SAE_PWE_BOTH
            bool "BOTH"
    endchoice

    config ESP_WIFI_PW_ID
        string "PASSWORD IDENTIFIER"
        depends on  ESP_WPA3_SAE_PWE_HASH_TO_ELEMENT|| ESP_WPA3_SAE_PWE_BOTH
        default ""
        help
            password identifier for SAE H2E

    config ESP_MAXIMUM_RETRY
        int "Maximum retry"
        default 420
        help
            Set the Maximum retry to avoid station reconnecting to the AP unlimited when the AP is really inexistent.

    choice ESP_WIFI_SCAN_AUTH_MODE_THRESHOLD
        prompt "WiFi Scan auth mode threshold"
        default ESP_WIFI_AUTH_WPA2_PSK
        help
            The weakest authmode to accept in the scan mode.
            This value defaults to ESP_WIFI_AUTH_WPA2_PSK incase password is present and ESP_WIFI_AUTH_OPEN is used.
            Please select ESP_WIFI_AUTH_WEP/ESP_WIFI_AUTH_WPA_PSK incase AP is operating in WEP/WPA mode.

        config ESP_WIFI_AUTH_OPEN
            bool "OPEN"
        config ESP_WIFI_AUTH_WEP
            bool "WEP"
        config ESP_WIFI_AUTH_WPA_PSK
            bool "WPA PSK"
        config ESP_WIFI_AUTH_WPA2_PSK
            bool "WPA2 PSK"
        config ESP_WIFI_AUTH_WPA_WPA2_PSK
            bool "WPA/WPA2 PSK"
        config ESP_WIFI_AUTH_WPA3_PSK
            bool "WPA3 PSK"
        config ESP_WIFI_AUTH_WPA2_WPA3_PSK
            bool "WPA2/WPA3 PSK"
        config ESP_WIFI_AUTH_WAPI_PSK
            bool "WAPI PSK"
    endchoice

endmenu
```

## sdkconfig.defaults
```kconfig
CONFIG_PARTITION_TABLE_CUSTOM=y
CONFIG_PARTITION_TABLE_CUSTOM_FILENAME="partitions.csv"
CONFIG_PARTITION_TABLE_FILENAME="partitions.csv"
CONFIG_PARTITION_TABLE_OFFSET=0x8000
CONFIG_PARTITION_TABLE_MD5=y
CONFIG_ESPTOOLPY_FLASHSIZE_16MB=y
CONFIG_ESPTOOLPY_FLASHSIZE="16MB"
CONFIG_HTTPD_WS_SUPPORT=y
CONFIG_SPIFFS_OBJ_NAME_LEN=64
CONFIG_HTTPD_MAX_URI_LEN=2048
CONFIG_LV_FONT_MONTSERRAT_10=y
CONFIG_LV_FONT_MONTSERRAT_14=y
CONFIG_LV_COLOR_16_SWAP=y

# optimize build
CONFIG_COMPILER_OPTIMIZATION_PERF=y
CONFIG_COMPILER_OPTIMIZATION_LEVEL_DEBUG=y

# psram config
CONFIG_ESP32S3_SPIRAM_SUPPORT=y
#CONFIG_SPIRAM_ALLOW_STACK_EXTERNAL_MEMORY=y
#CONFIG_SPIRAM_USE_MALLOC=y
# saves about 14kB internal RAM
CONFIG_SPIRAM_ALLOW_BSS_SEG_EXTERNAL_MEMORY=y
CONFIG_SPIRAM_BOOT_INIT=y
CONFIG_SPIRAM_MEMTEST=y
CONFIG_SPIRAM_MODE_OCT=y
CONFIG_SPIRAM_SPEED=40
CONFIG_SPIRAM_SPEED_40M=y
CONFIG_SPIRAM_TYPE_AUTO=y
CONFIG_SPIRAM_USE_CAPS_ALLOC=y
CONFIG_SPIRAM=y

CONFIG_ESP32S3_DEFAULT_CPU_FREQ_240=y
CONFIG_ESP_WIFI_11KV_SUPPORT=y

CONFIG_ESP_TLS_USING_MBEDTLS=y
CONFIG_ESP_TLS_USE_SECURE_ELEMENT=n
CONFIG_ESP_TLS_USE_DS_PERIPHERAL=n
CONFIG_MBEDTLS_EXTERNAL_MEM_ALLOC=y
CONFIG_MBEDTLS_SSL_IN_CONTENT_LEN=4096
CONFIG_MBEDTLS_SSL_OUT_CONTENT_LEN=4096

CONFIG_LWIP_MAX_SOCKETS=16
CONFIG_LWIP_STATS=y

CONFIG_I2C_ISR_IRAM_SAFE=y

#CONFIG_LOG_DEFAULT_LEVEL_DEBUG=y

# disable bluetooth
CONFIG_BT_ENABLED=n

# enable ansii colors for log
#CONFIG_LOG_COLORS=y

# disable wdt at boot
CONFIG_ESP_TASK_WDT_INIT=n

# disable cert check
CONFIG_ESP_TLS_INSECURE=y
CONFIG_ESP_TLS_SKIP_SERVER_CERT_VERIFY=y
```
